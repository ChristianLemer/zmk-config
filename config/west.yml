## config/west.yml
```yaml
manifest:
  remotes:
    - name: splitkb
      url-base: https://github.com/splitkb
  projects:
    - name: zmk
      remote: splitkb
      revision: main+halcyon-fixes
      import: app/west.yml
    - name: zmk-halcyon-module
      remote: splitkb
      revision: main
  self:
    path: config
```
